## conf/layer.conf
```bitbake
# We have a conf and classes directory, append to BBPATH
BBPATH .= ":${LAYERDIR}"

# We have a recipes directory, add to BBFILES
BBFILES += "${LAYERDIR}/recipes*/*/*.bb \
            ${LAYERDIR}/recipes*/*/*.bbappend"

BBFILE_COLLECTIONS += "meta-achilles"
BBFILE_PATTERN_meta-achilles := "^${LAYERDIR}/"
BBFILE_PRIORITY_meta-achilles = "7"
LAYERSERIES_COMPAT_meta-achilles = "gatesgarth"
LAYERDEPENDS_meta-achilles = "meta-intel-fpga"
BBDEBUG = "yes"
```

## conf/machine/achilles-factory.inc
```bitbake
#@TYPE: Machine
#@NAME: achilles-factory
#@DESCRIPTION: Factory machine configuration for REFLEX CES Achilles Arria 10 SoC SOMs

require conf/machine/include/socfpga.inc

PREFERRED_VERSION_u-boot-socfpga ?= "v2021.07%"

UBOOT_CONFIG ??= "boot-from-fpga"

UBOOT_SUFFIX = "sfp"
UBOOT_BINARY = "u-boot-with-spl.${UBOOT_SUFFIX}"

KMACHINE ?= "achilles-factory"

PREFERRED_PROVIDER_virtual/kernel = "linux-socfpga-lts"
PREFERRED_VERSION_linux-socfpga-lts = "5.10.%"

KERNEL_IMAGETYPE = "zImage"

SERIAL_CONSOLES ?= "115200;ttyS0"

EXTRA_IMAGEDEPENDS += "u-boot-socfpga"

INITRAMFS_IMAGE = "achilles-factory-image"
INITRAMFS_IMAGE_BUNDLE = "1"
```

## conf/machine/achilles-lite.conf
```bitbake
#@TYPE: Machine
#@NAME: achilles-lite
#@DESCRIPTION: Machine configuration for the REFLEX CES Achilles Arria 10 SoC Lite SOM 

SOM_VER = "lite"
GHRD_TYPE ?= "std"

require achilles.inc

UBOOT_CONFIG[achilles-lite] = "socfpga_arria10_achilles_lite_defconfig"

UBOOT_EXTLINUX_DEFAULT_LABEL ?= "Achilles Lite Arria 10 SOM eMMC"
UBOOT_EXTLINUX_MENU_DESCRIPTION:default ?= "Achilles Lite Arria 10 SOM eMMC"
```

## conf/machine/achilles-turbo.conf
```bitbake
#@TYPE: Machine
#@NAME: achilles-turbo
#@DESCRIPTION: Machine configuration for the REFLEX CES Achilles Arria 10 SoC Turbo SOM 

SOM_VER = "turbo"
GHRD_TYPE ?= "pr"

require achilles.inc

UBOOT_CONFIG[achilles-turbo] = "socfpga_arria10_achilles_turbo_defconfig"

UBOOT_EXTLINUX_DEFAULT_LABEL ?= "Achilles Turbo Arria 10 SOM eMMC"
UBOOT_EXTLINUX_MENU_DESCRIPTION:default ?= "Achilles Turbo Arria 10 SOM eMMC"
```

## conf/machine/achilles-v2-indus.conf
```bitbake
#@TYPE: Machine
#@NAME: achilles-v2-indus
#@DESCRIPTION: Machine configuration for the REFLEX CES Achilles v2 Arria 10 SoC Indus SOM 

SOM_REV = "v2"
SOM_VER = "indus"
GHRD_TYPE ?= "pr"

require achilles.inc

MACHINEOVERRIDES =. "achilles-v2:"

UBOOT_CONFIG ??= "mmc"
UBOOT_CONFIG[mmc] = "socfpga_arria10_achilles_v2_indus_defconfig"

UBOOT_EXTLINUX_FDT:default = "../socfpga_arria10_achilles_v2_indus.dtb"

UBOOT_EXTLINUX_DEFAULT_LABEL ??= "Achilles v2 Indus Arria 10 SOM eMMC"
UBOOT_EXTLINUX_MENU_DESCRIPTION:default ??= "Achilles v2 Indus Arria 10 SOM eMMC"

KMACHINE = "achilles-v2-indus"

KERNEL_DEVICETREE = "socfpga_arria10_achilles_v2_indus.dtb"
```

## conf/machine/achilles-v2-lite.conf
```bitbake
#@TYPE: Machine
#@NAME: achilles-v2-lite
#@DESCRIPTION: Machine configuration for the REFLEX CES Achilles v2 Arria 10 SoC Lite SOM 

SOM_REV = "v2"
SOM_VER = "lite"
GHRD_TYPE ?= "std"

require achilles.inc

MACHINEOVERRIDES =. "achilles-v2:"

UBOOT_CONFIG ??= "mmc"
UBOOT_CONFIG[mmc] = "socfpga_arria10_achilles_v2_lite_defconfig"

UBOOT_EXTLINUX_FDT:default = "../socfpga_arria10_achilles_v2_lite.dtb"

UBOOT_EXTLINUX_DEFAULT_LABEL ??= "Achilles v2 Lite Arria 10 SOM eMMC"
UBOOT_EXTLINUX_MENU_DESCRIPTION:default ??= "Achilles v2 Lite Arria 10 SOM eMMC"

KMACHINE = "achilles-v2-lite"

KERNEL_DEVICETREE = "socfpga_arria10_achilles_v2_lite.dtb"
```

## conf/machine/achilles-v2-turbo-factory.conf
```bitbake
#@TYPE: Machine
#@NAME: achilles-v2-turbo-factory
#@DESCRIPTION: Factory configuration for the REFLEX CES Achilles v2 Arria 10 SoC Turbo SOM

SOM_VER = "turbo"
GHRD_TYPE ?= "std"

require achilles-factory.inc

MACHINEOVERRIDES =. "achilles-v2:achilles-v2-factory:"

UBOOT_CONFIG ??= "boot-from-fpga"
UBOOT_CONFIG[boot-from-fpga] = "socfpga_arria10_achilles_v2_turbo_defconfig"

UBOOT_EXTLINUX_DEFAULT_LABEL ?= "Factory Achilles v2 Turbo Arria 10 SOM eMMC"
UBOOT_EXTLINUX_MENU_DESCRIPTION:default ?= "Factory Achilles v2 Turbo Arria 10 SOM eMMC"

KMACHINE = "achilles-v2-turbo-factory"
KERNEL_DEVICETREE = "socfpga_arria10_achilles_v2_turbo.dtb"
```

## conf/machine/achilles-v5-indus-factory.conf
```bitbake
#@TYPE: Machine
#@NAME: achilles-v5-indus-factory
#@DESCRIPTION: Factory configuration for the REFLEX CES Achilles v5 Arria 10 SoC Indus SOM 

SOM_REV = "v5"
SOM_VER = "indus"
GHRD_TYPE ?= "std"

require achilles-factory.inc

MACHINEOVERRIDES =. "achilles-v5:achilles-v5-factory:"

UBOOT_CONFIG ??= "boot-from-fpga"
UBOOT_CONFIG[boot-from-fpga] = "socfpga_arria10_achilles_v5_indus_defconfig"

UBOOT_EXTLINUX_DEFAULT_LABEL ?= "Factory Achilles v5 Indus Arria 10 SOM eMMC"
UBOOT_EXTLINUX_MENU_DESCRIPTION:default ?= "Factory Achilles v5 Indus Arria 10 SOM eMMC"

KMACHINE = "achilles-v5-indus-factory"
KERNEL_DEVICETREE = "socfpga_arria10_achilles_v5_indus.dtb"
```

## conf/machine/achilles-v5-indus.conf
```bitbake
#@TYPE: Machine
#@NAME: achilles-v5-indus
#@DESCRIPTION: Machine configuration for the REFLEX CES Achilles v5 Arria 10 SoC Indus SOM 

SOM_REV = "v5"
SOM_VER = "indus"
GHRD_TYPE ?= "pr"

require achilles.inc

MACHINEOVERRIDES =. "achilles-v5:"

UBOOT_CONFIG ??= "mmc"
UBOOT_CONFIG[mmc] = "socfpga_arria10_achilles_v5_indus_defconfig"

UBOOT_EXTLINUX_FDT:default = "../socfpga_arria10_achilles_v5_indus.dtb"

UBOOT_EXTLINUX_DEFAULT_LABEL ??= "Achilles v5 Indus Arria 10 SOM eMMC"
UBOOT_EXTLINUX_MENU_DESCRIPTION:default ??= "Achilles v5 Indus Arria 10 SOM eMMC"

KMACHINE = "achilles-v5-indus"

KERNEL_DEVICETREE = "socfpga_arria10_achilles_v5_indus.dtb"
```

## conf/machine/achilles-v5-lite.conf
```bitbake
#@TYPE: Machine
#@NAME: achilles-v5-lite
#@DESCRIPTION: Machine configuration for the REFLEX CES Achilles Arria 10 SoC Lite SOM 

SOM_REV = "v5"
SOM_VER = "lite"

require achilles.inc

MACHINEOVERRIDES =. "achilles-v5:"

UBOOT_CONFIG ??= "mmc"
UBOOT_CONFIG[mmc] = "socfpga_arria10_achilles_v5_lite_defconfig"

UBOOT_EXTLINUX_FDT:default = "../socfpga_arria10_achilles_v5_lite.dtb"

UBOOT_EXTLINUX_DEFAULT_LABEL ??= "Achilles v5 Lite Arria 10 SOM eMMC"
UBOOT_EXTLINUX_MENU_DESCRIPTION:default ??= "Achilles v5 Lite Arria 10 SOM eMMC"

KMACHINE = "achilles-v5-lite"

KERNEL_DEVICETREE = "socfpga_arria10_achilles_v5_lite.dtb"
```

## conf/machine/achilles.conf
```bitbake
#@TYPE: Machine
#@NAME: achilles
#@DESCRIPTION: Machine configuration for the REFLEX CES Achilles Arria 10 SoC SOM" 

require conf/machine/include/socfpga.inc

PREFERRED_VERSION_u-boot-socfpga ?= "v2021.01%"

SPL_BINARY = "spl/u-boot-splx4.sfp"
UBOOT_BINARY = "u-boot.img"

UBOOT_CONFIG ??= "achilles"

UBOOT_CONFIG[achilles] = "socfpga_arria10_achilles_defconfig"

KMACHINE = "achilles"

PREFERRED_PROVIDER_virtual/kernel = "linux-socfpga-lts"
PREFERRED_VERSION_linux-socfpga-lts = "5.4.%"

KERNEL_DEVICETREE ?= "socfpga_arria10_achilles.dtb"

SERIAL_CONSOLES ?= "115200;ttyS0"

UBOOT_EXTLINUX ?= "1"
UBOOT_EXTLINUX_LABELS ?= "default"
UBOOT_EXTLINUX_DEFAULT_LABEL ?= "Achilles Arria 10 SOM eMMC"

UBOOT_EXTLINUX_MENU_DESCRIPTION_default ?= "Achilles Arria 10 SOM eMMC"
UBOOT_EXTLINUX_KERNEL_IMAGE_default ?= "../${KERNEL_IMAGETYPE}"
UBOOT_EXTLINUX_FDT_default ?= "../socfpga_arria10_achilles.dtb"
UBOOT_EXTLINUX_KERNEL_ARGS_default ?= "rootwait rw earlycon"
UBOOT_EXTLINUX_ROOT_default ?= "root=/dev/mmcblk0p3"

IMAGE_BOOT_FILES ?= " \
        ${KERNEL_DEVICETREE} \
        ${KERNEL_IMAGETYPE} \
        ${UBOOT_BINARY} \
        extlinux.conf;extlinux/extlinux.conf \
        fit_spl_fpga_periph_only.itb \
        fit_spl_fpga.itb \
        achilles_ghrd.core.rbf \
        "

WKS_FILE ?= "emmcimage-achilles.wks"
IMAGE_FSTYPES +="wic"
```

## conf/machine/achilles.inc
```bitbake
#@TYPE: Machine
#@NAME: achilles
#@DESCRIPTION: Common machine configuration for REFLEX CES Achilles Arria 10 SoC SOMs 

require conf/machine/include/socfpga.inc

PREFERRED_VERSION_u-boot-socfpga ?= "v2021.07%"

UBOOT_CONFIG ??= "achilles-${SOM_VER}"

SPL_BINARY = "spl/u-boot-splx4.sfp"
UBOOT_BINARY = "u-boot.img"

KMACHINE = "achilles"

KERNEL_DEVICETREE ?= "socfpga_arria10_achilles.dtb"

PREFERRED_PROVIDER_virtual/kernel = "linux-socfpga-lts"
PREFERRED_VERSION_linux-socfpga-lts = "5.10.%"

SERIAL_CONSOLES ?= "115200;ttyS0"

UBOOT_EXTLINUX ?= "1"
UBOOT_EXTLINUX_LABELS ?= "default"
UBOOT_EXTLINUX_KERNEL_IMAGE:default ?= "../${KERNEL_IMAGETYPE}"
UBOOT_EXTLINUX_KERNEL_ARGS:default ?= "rootwait rw earlycon"
UBOOT_EXTLINUX_ROOT:default ?= "root=/dev/mmcblk0p3"
UBOOT_EXTLINUX_FDT:default ?= "../socfpga_arria10_achilles.dtb"

IMAGE_BOOT_FILES ?= " \
        ${KERNEL_DEVICETREE} \
        ${KERNEL_IMAGETYPE} \
        ${UBOOT_BINARY} \
        extlinux.conf;extlinux/extlinux.conf \
        fit_spl_fpga_periph_only.itb \
        fit_spl_fpga.itb \
        achilles_${SOM_VER}_ghrd.core.rbf \
        "

WKS_FILE ?= "emmcimage-achilles.wks"
IMAGE_FSTYPES +="wic"
```

## wic/emmcimage-achilles.wks
```
# short-description: Create an eMMC image for the REFLEX CES Achilles Arria 10 SoC SOM.
# long-description: Create an eMMC image for the REFLEX CES Achilles Arria 10 SoC SOM.
# partition 1: boot files (VFAT)
# partition 2: u-boot spl (A2)
# partition 3: rootfs (EXT3)

part --source bootimg-partition --ondisk mmcblk --fstype=vfat --label boot --active --align 1024 --size 100M
part --source rawcopy --sourceparams="file=u-boot-with-spl.sfp" --ondisk mmcblk --system-id=a2 --align 4 --fixed-size 10M
part / --source rootfs --ondisk mmcblk --fstype=ext3 --overhead-factor=1.5 --label root --align 4
```
